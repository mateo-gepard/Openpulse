// ═══════════════════════════════════════════════════════════════
// Firmware Implementation Template — Algo_${ID}.cpp
// ═══════════════════════════════════════════════════════════════
// Generated by OpenPulse Algorithm Builder
// Place at: firmware/src/algorithms/${LAYER}/Algo_${ID}.cpp
// ═══════════════════════════════════════════════════════════════

#include "Algo_${ID}.h"

// ═══════════════════════════════════════════════════════════════
// ${ID}: ${NAME}
// ${DESCRIPTION}
//
// Category:       ${CATEGORY}  (health-biometric | sport-motion | hybrid)
// Classification: ${CLASSIFICATION}
// Tier:           ${TIER}
// Consumes:       ${CHANNELS}
// Consumed by:    ${CONSUMED_BY}
// Citation:       ${PRIMARY_CITATION}
// ═══════════════════════════════════════════════════════════════

// ─── Constants ─────────────────────────────────────────────────
// NO magic numbers in algorithm code. Every constant named + cited.
namespace {
    // Sample rates and buffer sizes
    constexpr float    SAMPLE_RATE_HZ   = ${SAMPLE_RATE};
    constexpr uint16_t BUFFER_SIZE      = ${BUFFER_SIZE};

    // Algorithm-specific parameters (from spec Parameters table)
    // constexpr float PARAM_NAME = value;  // Meaning — Citation

    // Output range (physiological clamp OR sensible range)
    constexpr float OUTPUT_MIN = ${OUTPUT_MIN};
    constexpr float OUTPUT_MAX = ${OUTPUT_MAX};

    // SQI threshold (algorithm-specific, from spec)
    constexpr float SQI_THRESHOLD = ${SQI_THRESHOLD};

    // Helper: clamp to valid range
    inline float clampOutput(float v) {
        return (v < OUTPUT_MIN) ? OUTPUT_MIN : (v > OUTPUT_MAX) ? OUTPUT_MAX : v;
    }
}

// ─── Init ──────────────────────────────────────────────────────
void Algo_${ID}::init() {
    ${PRIMARY_BUFFER}.clear();
    state_ = AlgoState::ACQUIRING;
    output_ = {0, 0, 0, false};

    // Reset filter state
    // memset(sos_state_, 0, sizeof(sos_state_));

    // Reset algorithm-specific state
    // ${RESET_STATE}
}

// ─── Update ────────────────────────────────────────────────────
void Algo_${ID}::update(uint32_t now_ms) {
    // ── Step 1: Read input from sensor driver or dependency ──
    // float sample = driver->getLatestSample();
    // For cross-sensor: float sample2 = otherAlgo->getOutput().value;

    // ── Step 2: Motion check (if PPG/ECG-based) ─────────────
    // float motion = computeMotionLevel(now_ms);
    // if (motion > MOTION_THRESHOLD) {
    //     state_ = AlgoState::LOW_QUALITY;
    //     output_.sqi = 0;
    //     output_.valid = false;
    //     return;
    // }

    // ── Step 3: Preprocessing (filter, DC removal) ──────────
    // float filtered = applyFilter(sample);

    // ── Step 4: Push to ring buffer ─────────────────────────
    // ${PRIMARY_BUFFER}.push(filtered, now_ms);

    // ── Step 5: Check data sufficiency ──────────────────────
    // if (${PRIMARY_BUFFER}.count() < MIN_SAMPLES) {
    //     state_ = AlgoState::ACQUIRING;
    //     return;
    // }

    // ── Step 6: Compute SQI ─────────────────────────────────
    float sqi = computeSQI();
    if (sqi < SQI_THRESHOLD) {
        state_ = AlgoState::LOW_QUALITY;
        output_.sqi = sqi;
        output_.timestamp_ms = now_ms;
        output_.valid = false;
        return;
    }

    // ── Step 7: Algorithm core ──────────────────────────────
    // ${ALGORITHM_CORE}
    // Citation: ${FORMULA_CITATION}
    float result = 0.0f;

    // ── Step 8: Clamp output to valid range ─────────────────
    result = clampOutput(result);

    // ── Step 9: Update output ───────────────────────────────
    output_.value = result;
    output_.sqi = sqi;
    output_.timestamp_ms = now_ms;
    output_.valid = true;
    state_ = AlgoState::VALID;
}

// ─── SQI ───────────────────────────────────────────────────────
float Algo_${ID}::computeSQI() const {
    // Signal-specific quality assessment (0.0–1.0)
    // Typical factors (weight to sum = 1.0):
    //   PPG:  perfusion_index × 0.4 + waveform_quality × 0.3 + motion_level × 0.3
    //   ECG:  r_peak_snr × 0.5 + baseline_wander × 0.3 + electrode_quality × 0.2
    //   IMU:  no_clipping × 0.5 + variance_in_range × 0.5
    //   EDA:  no_saturation × 0.5 + variance_in_range × 0.5

    float sqi = 1.0f;  // Start at perfect, degrade based on quality factors

    // ${SQI_COMPUTATION}

    // Clamp SQI to [0, 1]
    if (sqi < 0.0f) sqi = 0.0f;
    if (sqi > 1.0f) sqi = 1.0f;
    return sqi;
}

// ─── Getters ───────────────────────────────────────────────────
AlgorithmOutput Algo_${ID}::getOutput() const { return output_; }
AlgoState Algo_${ID}::getState() const { return state_; }
